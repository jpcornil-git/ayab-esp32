## main/Kconfig.projbuild
```kconfig
menu "Ayab WebApp Configuration"

    config DEFAULT_WIFI_SSID
        string "WiFi SSID"
        default "AP Ayab Wifi"
        help
            WiFi SSID (network name) to connect to.

    config DEFAULT_WIFI_PASSWORD
        string "WiFi Password"
        default "ayabpass"
        help
            WiFi password (WPA or WPA2) of network.

    config DEFAULT_AYAB_HOSTNAME
        string "Hostname"
        default "ayab"
        help
            Hostname for this device.
endmenu
```

## sdkconfig.defaults
```kconfig
# UnoR4 target
CONFIG_IDF_TARGET="esp32s3"
CONFIG_ESPTOOLPY_FLASHSIZE_8MB=y
CONFIG_ESP_CONSOLE_USB_SERIAL_JTAG=y
# Custom partition table
CONFIG_PARTITION_TABLE_CUSTOM=y
# Enable rollback
CONFIG_BOOTLOADER_APP_ROLLBACK_ENABLE=y
# Logs
CONFIG_BOOT_ROM_LOG_ALWAYS_OFF=y
CONFIG_LOG_COLORS=y
# HTTPD
CONFIG_HTTPD_MAX_REQ_HDR_LEN=1024
CONFIG_HTTPD_WS_SUPPORT=y
```
